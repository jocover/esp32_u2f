## main/Kconfig.projbuild
```kconfig
menu "ESP32 U2F GPIO Configuration"

    orsource "$IDF_PATH/examples/common_components/env_caps/$IDF_TARGET/Kconfig.env_caps"

    config BLINK_GPIO
        int "Blink GPIO number"
        range ENV_GPIO_RANGE_MIN ENV_GPIO_OUT_RANGE_MAX
        default 15 if IDF_TARGET_ESP32S2
        default 48 if IDF_TARGET_ESP32S3
        default 8
        help
            GPIO number (IOxx) to blink on and off the LED.
            Some GPIOs are used for other purposes (flash connections, etc.) and cannot be used to blink.

    config BUTTON_ENABLE
        bool "enable Button support"
        default n
        help
            Use button to confirm enter,Default use automatically enter

    config BUTTON_GPIO
    	depends on BUTTON_ENABLE
        int "Button GPIO number"
        range ENV_GPIO_RANGE_MIN ENV_GPIO_OUT_RANGE_MAX
        default 0
        help
            Button number (IOxx) to button click.

endmenu
```
